/*-----------------------------------------------------------------
** 功能：此程序实现红外编解码及根据人体感应传感器感应信号，控制灯光
** 编写时间：2019-03-20
** 作者：刘全顺  邮箱：275292835@qq.com
** 说明：本程序配合万能红外遥控器（小米或其他厂家的）以及智能音箱，能实现语音控制
** 灯光及开门入户灯自动持续亮2分钟功能
--------------------------------------------------------------------
*/

#include "STC8.h"
#include "IRM3638T.h"
#include "uart.h"
#include "utils.h"


sbit humanSense = P3^2;/* 人体感应输入口，使用外部中断0 */
sbit ledCenter = P3^3; /* 客厅大灯 */
sbit ledNearDoor = P3^4;/* 入户花园灯  */


bit humanSenseFlag = 0;/* 人体感应标志，1表示感应到人经过 */
volatile unsigned int g_ulTimerCnt = 0;/* 定时器0计数变量 */

/*-------------------------------- ------------------------------------------------------------------
** 函数功能：初始化系统变量
** 入口参数：无
** 出口参数：无
** 返回值：无
** Note:如果不设置的话，可以直接通过stc-isp软件设置晶振频率
--------------------------------------------------------------------------------------------------*/
void Init_SysClk()
{
	#if 1
	P_SW2 = 0x80;
	IRTRIM = 0x6A;
	LIRTRIM = 0x02;
	CLKDIV = 0x02;
	P_SW2 = 0x00;
	#endif	
}

/*-------------------------------- ------------------------------------------------------------------
** 函数功能：主函数
** 入口参数：无
** 出口参数：无
** 返回值：无
** Note: 初始化PCA计数阵列、串口、GPIO、定时器0、外部中断0
--------------------------------------------------------------------------------------------------*/
void main(void)
{
	//Init_SysClk();
	UartInit();
	Init_CCP0();
	init_gpio();
	init_timer0();
	init_ext0();
	beep_control(1, 3000);
	EA = 1;
	
	humanSenseFlag = false;
	g_ulTimerCnt = 0;
	ledNearDoor = 1;
	ledCenter = 1;/* 初始化led灯为关闭状态，低电平触发继电器吸合 */
	
	UartSendStr("system is boot\r\n");
	while(1)
	{
        /* 人体感应标志位1，且持续时间超过了2分钟 */
		if (humanSenseFlag && g_ulTimerCnt > 100 * 120)
		{
			beep_control(1,1000);
			UartSendStr("humanSense end\r\n");
			humanSenseFlag = 0;
			g_ulTimerCnt = 0;
			ledNearDoor = 1;
			EX0 = 1;
		}
	}
}

/*-------------------------------- ------------------------------------------------------------------
** 函数功能：定时器0中断服务函数
** 入口参数：无
** 出口参数：无
** 返回值：无
** Note: 解码红外遥控信号、定时器计数
--------------------------------------------------------------------------------------------------*/
void TIMER0_ISR() interrupt 1
{
	Get_NEC_Message();/* 解码红外信号 */
	g_ulTimerCnt++;
}

/*-------------------------------- ------------------------------------------------------------------
** 函数功能：外部中断0服务函数
** 入口参数：无
** 出口参数：无
** 返回值：无
** Note: 检查人体感应信号，上升沿有效
--------------------------------------------------------------------------------------------------*/
void INT0_ISR() interrupt 0
{
	Delay1ms(1);/* 排除干扰信号 */
    /* 是上升沿 */
	if (humanSense == 1)
	{
		beep_control(1,1000);
	    humanSenseFlag = 1;/* 人体感应标志设置为1 */
		ledNearDoor = 0;/* 开入户灯 */
		//ledCenter = 0;
		g_ulTimerCnt = 0;
		UartSendStr("humanSense start\r\n");
		EX0 = 0;/* 禁止外部中断，入口灯持续亮2分钟后再接受人体感应信号 */
	}
	
}