#include "Uart.h"
#include "STC89C52RC.h"

/*串口计数用，最大*/
u8 g_aucRxBuffer[16]={0};
u8 g_ucRxCnt = 0;

/*-------------------------------- ------------------------------------------------------------------
** 函数功能： 串口通信初始化 
** 入口参数： 无
** 出口参数： 无
** 返回值：无
** Note:无
--------------------------------------------------------------------------------------------------*/
void InitRs232(void)
{
    SCON = 0x50;
    PCON = 0x00;
	TMOD = 0x20;
    TH1  = TL1 = -(FOSC/12/32/BAUD); //Set auto-reload vaule
    TR1  = 1;
    ES   = 1;
} 

/*-------------------------------- ------------------------------------------------------------------
** 函数功能：向串口发送一个字节
** 入口参数：发送的字符
** 出口参数： 无
** 返回值：无
** Note:无
--------------------------------------------------------------------------------------------------*/
void UartSendByte(u8 ch)
{
    ES  =  0;
    TI = 0;
    SBUF = ch;
    while(TI == 0);
    TI = 0;
    ES = 1;
}

/*-------------------------------- ------------------------------------------------------------------
** 函数功能：向串口发送一串字符
** 入口参数：发送的字符串
** 出口参数： 无
** 返回值：无
** Note:无
--------------------------------------------------------------------------------------------------*/
void UartSendStr(u8* pstr)
{
    while(*pstr)
    {
        UartSendByte(*pstr++);
    }

}


/*-------------------------------- ------------------------------------------------------------------
** 函数功能：串口中断，解析串口收到的指令
** 入口参数： 无
** 出口参数： 无
** 返回值：无
** Note:无
--------------------------------------------------------------------------------------------------*/
void Int_console() interrupt 4	  
{    
	u8  dat = 0x00;
	u8 i = 0;

	if (1 == RI)
	{
		dat = SBUF;
		RI = 0;
		g_aucRxBuffer[g_ucRxCnt] = dat;
		i = g_ucRxCnt;
		if(g_aucRxBuffer[g_ucRxCnt] == '#')
		{
			g_ucRxCnt = 0;
		}
		/* 连续16个字符未收到正确指令，清除收到的字符串*/
		g_ucRxCnt++;
		if(g_ucRxCnt >= MAX_BUFFER_SIZE)
		{
		   g_ucRxCnt = 0;
		}
	}
} 
